## conf/distro/rpcme-iot-riscv.conf
```bitbake
DISTRO_NAME = "rpcme-iot"
DISTRO_VERSION = "1.0.0"
DISTRO_CODENAME = "Viscous"

WKS_FILE = "freedom-u540-spl-opensbi-iot.wks"

USER_CLASSES ?= "buildstats buildhistory buildstats-summary image-prelink"

require conf/distro/include/yocto-uninative.inc
require conf/distro/include/security_flags.inc

INHERIT += "uninative"

DISTRO_FEATURES:append = " largefile ptest multiarch systemd"
VIRTUAL-RUNTIME_init_manager = "systemd"
VIRTUAL-RUNTIME_initscripts = ""
VIRTUAL-RUNTIME_syslog = ""


VIRTUAL-RUNTIME_login_manager = "shadow-base"
HOSTTOOLS_NONFATAL:append = " ssh"

PREFERRED_PROVIDER_base-utils = "packagegroup-core-base-utils"
VIRTUAL-RUNTIME_base-utils = "packagegroup-core-base-utils"
VIRTUAL-RUNTIME_base-utils-hwclock = "util-linux-hwclock"
VIRTUAL-RUNTIME_base-utils-syslog = ""

SECURITY_CFLAGS:pn-opensbi = ""
SECURITY_LDFLAGS:pn-opensbi = ""

PACKAGECONFIG:append:pn-gdb = " python"
PACKAGECONFIG:append:pn-gdb = " tui"
PACKAGECONFIG:append:pn-gdb = " xz"

PACKAGECONFIG:append:pn-elfutils = " bzip2"
PACKAGECONFIG:append:pn-elfutils = " xz"

PACKAGECONFIG:append:pn-perf = " dwarf"
PACKAGECONFIG:append:pn-perf = " libunwind"
PACKAGECONFIG:append:pn-perf = " jvmti"
PACKAGECONFIG:append:pn-perf = " cap"

PACKAGECONFIG:append:pn-perl = " bdb"

# All samples
PACKAGECONFIG:remove:pn-aws-iot-device-client = " samples"
# Pubsub sample
PACKAGECONFIG:remove:pn-aws-iot-device-client = " pubsub"
# Device Defender
PACKAGECONFIG:remove:pn-aws-iot-device-client = " dd"
# Fleet management - provisioning
PACKAGECONFIG:append:pn-aws-iot-device-client = " fp"
# Fleet management - jobs
PACKAGECONFIG:remove:pn-aws-iot-device-client = " jobs"
# Secure tunneling
PACKAGECONFIG:remove:pn-aws-iot-device-client = " st"
# Device shadow
PACKAGECONFIG:remove:pn-aws-iot-device-client = " ds"
# Device shadow - config shadow
PACKAGECONFIG:remove:pn-aws-iot-device-client = " dsc"
# Device shadow - named shadow
PACKAGECONFIG:remove:pn-aws-iot-device-client = " dsn"

QEMU_TARGETS = "riscv64 x86_64"

CLANGSDK = "1"

FORTRAN:forcevariable = ",fortran"

BBMASK += "openembedded-core/meta/recipes-bsp/opensbi/opensbi_0.9.bb"
```

## conf/layer.conf
```bitbake
# We have a conf and classes directory, add to BBPATH
BBPATH .= ":${LAYERDIR}"

# We have recipes-* directories, add to BBFILES
BBFILES += "${LAYERDIR}/recipes-*/*/*.bb \
            ${LAYERDIR}/recipes-*/*/*.bbappend"

BBFILE_COLLECTIONS += "meta-rpcme-iot-distro"
BBFILE_PATTERN_meta-rpcme-iot-distro = "^${LAYERDIR}/"
BBFILE_PRIORITY_meta-rpcme-iot-distro = "6"

LAYERDEPENDS_meta-rpcme-iot-distro = "core"
LAYERSERIES_COMPAT_meta-rpcme-iot-distro = "honister"
```
